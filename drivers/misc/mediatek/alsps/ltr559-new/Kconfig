## drivers/misc/mediatek/flightsense/vl53l0/Kconfig
```kconfig
config MTK_VL53L0
	bool "MTK_VL53L0 for MediaTek package"
	default n
	help
	It support different type sensor
	in this platform. If this option
	is set, it will support ambient
	and light sensor MTK_VL53L0.
```

## drivers/misc/mediatek/hallswitch/ah1887/Kconfig
```kconfig
config MTK_AH1887
	bool "MTK_AH1887 for MediaTek package"
	default n
	help
	It support different type sensor
	in this platform. If this option
	is set, it will support ambient
	and light sensor MTK_AH1887.
```

## drivers/misc/mediatek/magnetometer/mmc3530kj-new/Kconfig
```kconfig
config MTK_MMC3530KJ_NEW
	bool "MMC3530KJ for MediaTek package"
	default n
	help
	  It support different magnetometer sensor.
          If this option is set,
	  it will support
          MMC3530KJ magnetometer.
```
